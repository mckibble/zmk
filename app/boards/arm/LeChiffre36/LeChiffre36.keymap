/*
 * Copyright (c) 2023 ZitaoTech
 *
 * SPDX-License-Identifier: MIT
 */

#include <behaviors.dtsi>
#include <dt-bindings/zmk/keys.h>
#include <dt-bindings/zmk/bt.h>
#include <dt-bindings/zmk/outputs.h>
#include <dt-bindings/zmk/mouse.h>
#include <dt-bindings/zmk/backlight.h>
#include <dt-bindings/zmk/ext_power.h>


#define SYM 1
#define UPPER 2


/ {

    keymap {
        compatible = "zmk,keymap";

        default_layer {

            bindings = <

                 &kp A
            >;
        };
    };
};

