## app/boards/arm/LeChiffre36/Kconfig.board
```kconfig
# Copyright (c) 2023 ZitaoTech
# SPDX-License-Identifier: MIT

config BOARD_LECHIFFRE36
    bool "lechiffre36"
    depends on SOC_NRF52840_QIAA
```

## app/boards/arm/LeChiffre36/Kconfig.defconfig
```kconfig
# Copyright (c) 2023 ZitaoTech
# SPDX-License-Identifier: MIT

if BOARD_LECHIFFRE36

config ZMK_KEYBOARD_NAME
    default "lechiffre36"

if USB_DEVICE_STACK

config USB_NRFX
    default y

endif # USB_DEVICE_STACK

if ZMK_BACKLIGHT

config PWM
    default y

config LED_PWM
    default y

endif # ZMK_BACKLIGHT


config BT_CTLR
    default BT

if ZMK_DISPLAY

config LPM009M360A
	default y

config SPI
    default y
    
endif # ZMK_DISPLAY

if LVGL
config ZMK_DISPLAY_DEDICATED_THREAD_STACK_SIZE
	default 8192

#config LV_HOR_RES_MAX
	#default 128
#config LV_VER_RES_MAX
	#default 32
config LV_Z_VDB_SIZE
	default 64

config LV_DPI_DEF
	default 70
config LV_Z_BITS_PER_PIXEL
	default 1
choice LV_COLOR_DEPTH
	default LV_COLOR_DEPTH_1
endchoice

endif # LVGL

config ZMK_WIDGET_WPM_STATUS
	default y

endif # BOARD_LECHIFFRE36
```

## app/boards/arm/LeChiffre36/LeChiffre36_defconfig
```kconfig
# Copyright (c) 2023 ZitaoTech
# SPDX-License-Identifier: MIT

CONFIG_SOC_SERIES_NRF52X=y
CONFIG_SOC_NRF52840_QIAA=y
CONFIG_BOARD_LECHIFFRE36=y


# Enable MPU
CONFIG_ARM_MPU=y

CONFIG_PINCTRL=y

# enable GPIO
CONFIG_GPIO=y

# Build Configuration
CONFIG_USE_DT_CODE_PARTITION=y
CONFIG_BUILD_OUTPUT_UF2=y

# Flash configuration
CONFIG_MPU_ALLOW_FLASH_WRITE=y
CONFIG_NVS=y
CONFIG_SETTINGS_NVS=y
CONFIG_FLASH=y
CONFIG_FLASH_PAGE_LAYOUT=y
CONFIG_FLASH_MAP=y

# Enable Signal Power Plus
CONFIG_BT_CTLR_TX_PWR_PLUS_8=y

# Sleep Setting
CONFIG_ZMK_SLEEP=n
CONFIG_ZMK_EXT_POWER=y
# timeout for backlight for keyboard in miliseconds
CONFIG_ZMK_IDLE_TIMEOUT=30000                         
             
# HID indicator configuration
CONFIG_ZMK_HID_INDICATORS=y

# Setting for Scrolling of trackpad
# set the scroll interval; the highter this value, the slower trackpad scrolls                   
CONFIG_TRACKPAD_SCROLL_INTERVAL=20                    

# Enable Mouse Emulation
CONFIG_ZMK_MOUSE=y
# Mouse Speed Multiplier in horizontal direction
CONFIG_TRACKPAD_SPEEDMULTIPLIER_HORIZONTAL=1
# Mouse Speed Multiplier in vertical direction
CONFIG_TRACKPAD_SPEEDMULTIPLIER_VERTICAL=1

# Debuncing Setting 
CONFIG_ZMK_KSCAN_DEBOUNCE_PRESS_MS=10
CONFIG_ZMK_KSCAN_DEBOUNCE_RELEASE_MS=10

# Enable both USB and BLE
CONFIG_ZMK_USB=y
CONFIG_ZMK_BLE=n


# Milliseconds to wait after a setting change before writing it to flash memory
CONFIG_ZMK_SETTINGS_SAVE_DEBOUNCE=10000

# Log via USB or Segger RTTc
CONFIG_ZMK_USB_LOGGING=n
```

## app/boards/arm/bbcase/bbcase_defconfig
```kconfig
# Copyright (c) 2023 The ZMK Contributors
# SPDX-License-Identifier: MIT

# Basic Setting of RP2040
CONFIG_SOC_SERIES_RP2XXX=y
CONFIG_SOC_RP2040=y
CONFIG_BOARD_BBCASE=y
CONFIG_SYS_CLOCK_HW_CYCLES_PER_SEC=240000000
CONFIG_PINCTRL=y

# Output UF2 by default, native bootloader supports it.
CONFIG_BUILD_OUTPUT_UF2=y

# Sleep Setting
CONFIG_ZMK_SLEEP=n
CONFIG_ZMK_EXT_POWER=y
CONFIG_ZMK_IDLE_TIMEOUT=30000
  

# Enable Mouse Emulation
CONFIG_ZMK_MOUSE=y
# Mouse Speed Multiplier in horizontal direction
CONFIG_TRACKPAD_SPEEDMULTIPLIER_HORIZONTAL=1
# Mouse Speed Multiplier in vertical direction
CONFIG_TRACKPAD_SPEEDMULTIPLIER_VERTICAL=1

# Debuncing Setting 
CONFIG_ZMK_KSCAN_DEBOUNCE_PRESS_MS=10
CONFIG_ZMK_KSCAN_DEBOUNCE_RELEASE_MS=10

# HID indicator configuration
CONFIG_ZMK_HID_INDICATORS=y


# Enable reset by default
CONFIG_RESET=y
CONFIG_PWM=y

# Code partition needed to target the correct flash range
CONFIG_USE_DT_CODE_PARTITION=y

#USB Output
CONFIG_ZMK_USB=y

# Enable USB CDC ACM logging for debugging
CONFIG_ZMK_USB_LOGGING=y
```
