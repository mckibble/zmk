/*
 * Copyright (c) 2023 ZitaoTech
 *
 * SPDX-License-Identifier: MIT
 */

#include <behaviors.dtsi>
#include <dt-bindings/zmk/keys.h>
#include <dt-bindings/zmk/outputs.h>
#include <dt-bindings/zmk/mouse.h>
#include <dt-bindings/zmk/backlight.h>
#include <dt-bindings/zmk/ext_power.h>



/ {



    keymap {
        compatible = "zmk,keymap";

        default_layer {

            bindings = <
//         --------------------------------------------------------------------------------------------------------------------------         
//         |    Shoulder Key1    |                                                                             |    Shoulder Key2    |     
// |         Call key      |      Blackberry Key        |    Trackpad    |             Back Key                |             Endcall Key          |
// |     Q      |     W    |     E    |     R    |      T      |       Y        |       U        |        I        |       O      |      P        |     
// |     A      |     S    |     D    |     F    |      G      |       H        |       J        |        K        |       L      |      ←        |  
// |     alt    |     Z    |     X    |     C    |      V      |       B        |       N        |        M        |       $      |    Enter      |   
//        |         aA     |         0           |           SPACE              |         SYM         |        aA          |       
//        -----------------------------------------------------------------------------------------------------------------

                 &mkp LCLK 
            >;
        };
    };
};
